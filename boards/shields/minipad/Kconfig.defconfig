## boards/shields/minipad/Kconfig.defconfig
```kconfig
if SHIELD_MINIPAD

# Name must be less than 16 characters long!
config ZMK_KEYBOARD_NAME
    default "Minipad"

endif
```

## boards/shields/minipad/Kconfig.shield
```kconfig
config SHIELD_MINIPAD
    def_bool $(shields_list_contains,minipad)

config SHIELD_MINIPAD
    def_bool $(shields_list_contains,minipad_dongle)
```
